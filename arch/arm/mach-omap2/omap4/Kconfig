## arch/arm/mach-omap2/omap4/Kconfig
```kconfig
if OMAP44XX

choice
	prompt "OMAP4 board select"
	optional

config TARGET_OMAP4_PANDA
	bool "TI OMAP4 PandaBoard"

config TARGET_OMAP4_SDP4430
	bool "TI OMAP4 SDP4430"

config TARGET_OMAP4_EMBT2WS
	bool "EPSOM EMBT2WS (Moverio BT-200)"

endchoice

config SYS_SOC
	default "omap4"

source "board/ti/panda/Kconfig"
source "board/ti/sdp4430/Kconfig"
source "board/epson/embt2ws/Kconfig"

endif
```

## board/epson/embt2ws/Kconfig
```kconfig
if TARGET_OMAP4_EMBT2WS

config SYS_BOARD
	default "embt2ws"

config SYS_VENDOR
	default "epson"

config SYS_CONFIG_NAME
	default "omap4_embt2ws"

endif
```

## configs/omap4_embt2ws_defconfig
```kconfig
CONFIG_ARM=y
CONFIG_ARCH_OMAP2PLUS=y
CONFIG_SUPPORT_PASSING_ATAGS=y
CONFIG_CMDLINE_TAG=y
CONFIG_INITRD_TAG=y
CONFIG_SYS_MALLOC_F_LEN=0x4000
CONFIG_DEFAULT_DEVICE_TREE="omap4-epson-embt2ws"
CONFIG_SPL_TEXT_BASE=0x40300000
CONFIG_OMAP44XX=y
CONFIG_TARGET_OMAP4_EMBT2WS=y
CONFIG_SPL=y
# CONFIG_SPL_FS_FAT is not set
CONFIG_DISTRO_DEFAULTS=y
CONFIG_HAS_CUSTOM_SYS_INIT_SP_ADDR=y
CONFIG_CUSTOM_SYS_INIT_SP_ADDR=0x4030df00
CONFIG_BOOTCOMMAND="if test ${boot_fit} -eq 1; then run update_to_fit; fi; run findfdt; run init_console; run envboot; run distro_bootcmd"
CONFIG_DEFAULT_FDT_FILE="omap4-epson-embt2ws.dtb"
CONFIG_SYS_CONSOLE_IS_IN_ENV=y
CONFIG_SYS_CONSOLE_INFO_QUIET=y
CONFIG_SPL_MAX_SIZE=0xbc00
CONFIG_SYS_SPL_MALLOC=y
CONFIG_SYS_SPL_MALLOC_SIZE=0x800000
CONFIG_SYS_MMCSD_RAW_MODE_U_BOOT_SECTOR=0x200
# CONFIG_SPL_FS_EXT4 is not set
# CONFIG_SPL_I2C is not set
# CONFIG_SPL_NAND_SUPPORT is not set
# CONFIG_SPL_NAND_SIMPLE is not set
CONFIG_SYS_MAXARGS=64
CONFIG_CMD_SPL=y
CONFIG_CMD_ASKENV=y
CONFIG_CMD_GPIO=y
CONFIG_CMD_I2C=y
CONFIG_CMD_MMC=y
CONFIG_CMD_USB_MASS_STORAGE=y
# CONFIG_CMD_SETEXPR is not set
CONFIG_CMD_EXT4_WRITE=y
CONFIG_OF_CONTROL=y
CONFIG_ENV_OVERWRITE=y
CONFIG_ENV_IS_IN_FAT=y
CONFIG_ENV_FAT_DEVICE_AND_PART="0:1"
CONFIG_SYS_RELOC_GD_ENV_ADDR=y
CONFIG_ENV_VARS_UBOOT_RUNTIME_CONFIG=y
CONFIG_VERSION_VARIABLE=y
# CONFIG_NET is not set
CONFIG_DM=y
CONFIG_USB_FUNCTION_FASTBOOT=y
CONFIG_SYS_I2C_LEGACY=y
CONFIG_SPL_SYS_I2C_LEGACY=y
CONFIG_MMC_OMAP_HS=y
CONFIG_PHY=y
CONFIG_NOP_PHY=y
CONFIG_CONS_INDEX=3
CONFIG_SYS_NS16550=y
CONFIG_USB=y
CONFIG_DM_USB_GADGET=y
CONFIG_USB_MUSB_GADGET=y
CONFIG_USB_MUSB_OMAP2PLUS=y
CONFIG_USB_GADGET=y
CONFIG_USB_GADGET_VENDOR_NUM=0x6666
CONFIG_USB_GADGET_PRODUCT_NUM=0x4444
CONFIG_USB_FUNCTION_ACM=y
```
